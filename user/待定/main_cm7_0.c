
#include "zf_common_headfile.h"
#pragma section all "cpu0_dsram"

/*

           _____ _____ _______      ____  _____  _____  _   _         _____ _____   _____       _____ ____  _____  ______
     /\   |_   _|_   _|__   __|    / __ \|  __ \|  __ \| \ | |       / ____|  __ \ / ____|     / ____/ __ \|  __ \|  ____|
    /  \    | |   | |    | |______| |  | | |__) | |__) |  \| |______| |    | |__) | |   ______| |   | |  | | |  | | |__
   / /\ \   | |   | |    | |______| |  | |  _  /|  _  /| . ` |______| |    |  _  /| |  |______| |   | |  | | |  | |  __|
  / ____ \ _| |_ _| |_   | |      | |__| | | \ \| | \ \| |\  |      | |____| | \ \| |____     | |___| |__| | |__| | |____
 /_/    \_\_____|_____|  |_|       \____/|_|  \_\_|  \_\_| \_|       \_____|_|  \_\\_____|     \_____\____/|_____/|______|

//31.34S/100M
//比赛结束之后我感觉大脑空白，但是大家想一想，失败总是贯穿人生始终，这就是人生-----SHOWMAKER
//我会用接下来的时间追上这四秒
//本代码FLASH存点方式储存GPS坐标点存在丢失较大精度的问题，且遍历坐标点数组方式需要更改，建议改为固定数组循环读取数组长度而不是通过计算数组元素个数来循环读取
//建议使用数组的方式吗，虽然需要跑一次采集一次点位但是很准，因为double类型数组能最大程度的避免软件层面造成打误差----于我而言

*/
// **************************** 代码区域 ****************************

int core0_main(void)
{
    clock_init();                   // 获取时钟频率<务必保留>
    debug_init();                   // 初始化默认调试串口

    //初始化代码
     ALL_Init();

#if ISR_Start_FLAG

     pit_us_init(CCU60_CH1, 10);                               // LORA中断
     pit_ms_init(CCU61_CH0, 100);                            // GPS数据解析中断/霍尔编码器中断
     pit_ms_init(CCU61_CH1, 7);                              // 舵机

#endif

     Ctrl_GO_FLAG=0; //清除标志位
     Buzzer_check(200,200);                                  // 自检完成
    // 初始化代码

    cpu_wait_event_ready();         // 等待所有核心初始化完毕



    while (TRUE)
    {

        #if Main_FLAG
                         if(x6f_out[0]<135) {Ctrl_GO_FLAG=1;}//控制发车标志位

                         if(GO_FLAG==1)
                           {

                             if(Ctrl_GO_FLAG==1&&Control_FLAG==1) {Follow_Track();}//核心循迹程序
                             if(x6f_out[2]>165&&x6f_out[2]<175)//有控模式
                             {
                                  Control_FLAG=0;
                                  Control_Program();//控制程序
                             }
                           }

                         if(STOP_MENU_FALG){Menu();}//菜单
        #endif

                         GL_CRC();

                         if(GL_IMU_Flag==1) {Follow_Track();}//核心循迹程序
                         if(x6f_out[2]>165&&x6f_out[2]<175)//有控模式
                         {
                              Control_FLAG=0;
                              GL_IMU_Flag=0;
                              Control_Program();//控制程序
                         }



    }
}

#pragma section all restore
// **************************** 代码区域 ****************************
























































































































































































































































































































































































































































































































































































































































































































































































































































































































































/*
 *
 * 2023.8.02---00:17
 * 虽然叫省三就算成功,可谁又愿意真的省三呢
 * 第17届我没努力拿了省三，我并不觉得失落和遗憾
 * 第18届我写了半年的代码，结果只能拿个省一，前5名进国赛，我第7名离国赛标准差了4秒
 * 讲什么都没用了，和队友说着无所谓，尽力就好，但是这种努力过了没有用的感觉太让人窒息了
 * 嘴上说着自己已经努力过了，剩下全看天意了，可人生不如意之事十之八九，但就算被打的遍体鳞伤也得接着走下去
 * 如果你大一，珍惜时光，把这当作你自己最后一场比赛去跑吧
 * 如果你大二，珍惜时光，这是你最后一次机会了
 * 如果你大三，不要参加智能车比赛了！！！！！！！！！！！！！！！！！！！！！！！！！！！！！！！！！！！！！！！！！！！！！！！！！！！！！！
 * 希望你能在这份代码里获得你想要的,希望你能进国赛
 *
 *
 *
 *
 * 一切顺利的话，我们的道路将不在交汇，可惜从来都不顺利
 *
 * -------ORRN/省三就算成功/詹海翔/LOSER
 */
